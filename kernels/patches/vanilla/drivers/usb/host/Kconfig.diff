## kernels/patches/vanilla/drivers/usb/host/Kconfig.diff
```kconfig
--- ./vanilla//drivers/usb/host/Kconfig	2010-02-23 17:38:51.000000000 +0200
+++ ./default//drivers/usb/host/Kconfig	2012-05-23 10:43:59.593935419 +0300
@@ -59,6 +59,20 @@
 	  To compile this driver as a module, choose M here: the
 	  module will be called ehci-hcd.
 
+config USB_EHCI_EHSET
+	bool "Embedded High-speed Host Electrical Test Support"
+	depends on USB_EHCI_HCD
+	default n
+	---help---
+	  This option is required for EHSET Host Compliance Tests support on an
+	  embedded Hi-speed USB Host or OTG port.
+
+	  This enables the software support for the "Single Step Set Featue" test.
+	  Apart from this test, other EHSET tests TEST_SE0/J/K/PACKET are part
+	  of EHCI specification and their support already exists in the EHCI driver.
+
+	  If unsure, say N.
+
 config USB_EHCI_ROOT_HUB_TT
 	bool "Root Hub Transaction Translators"
 	depends on USB_EHCI_HCD
@@ -132,6 +146,21 @@
 	  To compile this driver as a module, choose M here: the
 	  module will be called oxu210hp-hcd.
 
+config USB_EHCI_MSM
+	bool "Support for Qualcomm on-chip EHCI USB controller"
+	depends on USB_EHCI_HCD && USB_MSM_OTG_72K && ARCH_MSM
+	---help---
+	  Enables support for the USB controller present on the
+	  Qualcomm chipsets.
+
+config USB_FS_HOST
+	bool "Support for Full Speed Host Mode"
+	depends on USB_EHCI_MSM && ARCH_QSD8X50
+	default n
+	---help---
+	  Enables support for the full speed USB controller core present
+	  on the Qualcomm chipsets
+
 config USB_ISP116X_HCD
 	tristate "ISP116X HCD support"
 	depends on USB
```

## kernels/patches/vanilla/drivers/usb/misc/Kconfig.diff
```kconfig
--- ./vanilla//drivers/usb/misc/Kconfig	2010-02-23 17:38:51.000000000 +0200
+++ ./default//drivers/usb/misc/Kconfig	2012-05-23 10:44:04.107935220 +0300
@@ -229,6 +229,21 @@
 	  See <http://www.linux-usb.org/usbtest/> for more information,
 	  including sample test device firmware and "how to use it".
 
+config USB_EHSET_TEST_FIXTURE
+	tristate "USB EHSET Test Fixture Driver"
+	depends on USB && USB_EHCI_EHSET
+	default n
+	help
+	  Say Y here if you want to use EHSET Test Fixture device for host
+	  compliance testing.
+
+	  This driver initiates test modes on the downstream port to which the
+	  test fixture is attached.
+
+	  See <http://www.usb.org/developers/onthego/EHSET_v1.01.pdf>
+	  for more information.
+
+
 config USB_ISIGHTFW
 	tristate "iSight firmware loading support"
 	depends on USB
```

## kernels/patches/vanilla/drivers/usb/otg/Kconfig.diff
```kconfig
--- ./vanilla//drivers/usb/otg/Kconfig	2010-02-23 17:38:51.000000000 +0200
+++ ./default//drivers/usb/otg/Kconfig	2012-05-23 10:44:04.117935219 +0300
@@ -51,6 +51,15 @@
 	  This transceiver supports high and full speed devices plus,
 	  in host mode, low speed.
 
+config USB_MSM_OTG_72K
+	bool "OTG support for Qualcomm on-chip USB controller"
+	depends on ARCH_MSM
+	select USB_OTG_UTILS
+	default USB_MSM_72K
+	help
+	  Minimal tranceiver driver which would start/stop the host/gadget
+	  depending on ID and VBUS interrupts.
+
 config NOP_USB_XCEIV
 	tristate "NOP USB Transceiver Driver"
 	select USB_OTG_UTILS
```

## kernels/patches/vanilla/fs/Kconfig.diff
```kconfig
--- ./vanilla//fs/Kconfig	2010-02-23 17:38:51.000000000 +0200
+++ ./default//fs/Kconfig	2012-05-23 10:44:04.288935212 +0300
@@ -174,6 +174,10 @@
 source "fs/befs/Kconfig"
 source "fs/bfs/Kconfig"
 source "fs/efs/Kconfig"
+
+# Patched by YAFFS
+source "fs/yaffs2/Kconfig"
+
 source "fs/jffs2/Kconfig"
 # UBIFS File system configuration
 source "fs/ubifs/Kconfig"
```

## kernels/patches/vanilla/fs/fat/Kconfig.diff
```kconfig
--- ./vanilla//fs/fat/Kconfig	2010-02-23 17:38:51.000000000 +0200
+++ ./default//fs/fat/Kconfig	2012-05-23 10:44:04.348935207 +0300
@@ -83,6 +83,26 @@
 	  It can be overridden with the "codepage" mount option.
 	  See <file:Documentation/filesystems/vfat.txt> for more information.
 
+config VFAT_FS_DUALNAMES
+	bool "VFAT dual names support"
+	depends on VFAT_FS
+	help
+	  This option provides support for dual filenames on VFAT filesystems.
+  	  If this option is disabled then file creation will either put
+  	  a short (8.3) name or a long name on the file, but never both.
+  	  The field where a shortname would normally go is filled with
+  	  invalid characters such that it cannot be considered a valid
+  	  short filename.
+  	  
+  	  That means that long filenames created with this option
+  	  disabled will not be accessible at all to operating systems
+	  that do not understand the VFAT extensions.
+			  	  	  	  	  	  	  	  
+  	  Users considering enabling this option should consider the implications
+  	  of any patents that may exist on dual filenames in VFAT.
+  	  
+  	  If unsure, say N
+
 config FAT_DEFAULT_IOCHARSET
 	string "Default iocharset for FAT"
 	depends on VFAT_FS
```

## kernels/patches/vanilla/init/Kconfig.diff
```kconfig
--- ./vanilla//init/Kconfig	2010-02-23 17:38:51.000000000 +0200
+++ ./default//init/Kconfig	2012-05-23 10:44:04.714935193 +0300
@@ -737,6 +737,12 @@
 config ANON_INODES
 	bool
 
+config PANIC_TIMEOUT
+	int "Default panic timeout"
+	default 0
+	help
+	  Set default panic timeout.
+
 menuconfig EMBEDDED
 	bool "Configure standard kernel features (for small systems)"
 	help
@@ -908,6 +914,15 @@
 	  option replaces shmem and tmpfs with the much simpler ramfs code,
 	  which may be appropriate on small systems without swap.
 
+config ASHMEM
+	bool "Enable the Anonymous Shared Memory Subsystem"
+	default n
+	depends on SHMEM || TINY_SHMEM
+	help
+	  The ashmem subsystem is a new shared memory allocator, similar to
+	  POSIX SHM but with different behavior and sporting a simpler
+	  file-based API.
+
 config AIO
 	bool "Enable AIO support" if EMBEDDED
 	default y
```

## kernels/patches/vanilla/kernel/power/Kconfig.diff
```kconfig
--- ./vanilla//kernel/power/Kconfig	2010-02-23 17:38:51.000000000 +0200
+++ ./default//kernel/power/Kconfig	2012-05-23 10:44:04.730935191 +0300
@@ -119,6 +119,73 @@
 config HIBERNATION_NVS
 	bool
 
+config HAS_WAKELOCK
+	bool
+
+config HAS_EARLYSUSPEND
+	bool
+
+config WAKELOCK
+	bool "Wake lock"
+	depends on PM && RTC_CLASS
+	default n
+	select HAS_WAKELOCK
+	---help---
+	  Enable wakelocks. When user space request a sleep state the
+	  sleep request will be delayed until no wake locks are held.
+
+config WAKELOCK_STAT
+	bool "Wake lock stats"
+	depends on WAKELOCK
+	default y
+	---help---
+	  Report wake lock stats in /proc/wakelocks
+
+config USER_WAKELOCK
+	bool "Userspace wake locks"
+	depends on WAKELOCK
+	default y
+	---help---
+	  User-space wake lock api. Write "lockname" or "lockname timeout"
+	  to /sys/power/wake_lock lock and if needed create a wake lock.
+	  Write "lockname" to /sys/power/wake_unlock to unlock a user wake
+	  lock.
+
+config EARLYSUSPEND
+	bool "Early suspend"
+	depends on WAKELOCK
+	default y
+	select HAS_EARLYSUSPEND
+	---help---
+	  Call early suspend handlers when the user requested sleep state
+	  changes.
+
+choice
+	prompt "User-space screen access"
+	default FB_EARLYSUSPEND if !FRAMEBUFFER_CONSOLE
+	default CONSOLE_EARLYSUSPEND
+	depends on HAS_EARLYSUSPEND
+
+	config NO_USER_SPACE_SCREEN_ACCESS_CONTROL
+		bool "None"
+
+	config CONSOLE_EARLYSUSPEND
+		bool "Console switch on early-suspend"
+		depends on HAS_EARLYSUSPEND && VT
+		---help---
+		  Register early suspend handler to perform a console switch to
+		  when user-space should stop drawing to the screen and a switch
+		  back when it should resume.
+
+	config FB_EARLYSUSPEND
+		bool "Sysfs interface"
+		depends on HAS_EARLYSUSPEND
+		---help---
+		  Register early suspend handler that notifies and waits for
+		  user-space through sysfs when user-space should stop drawing
+		  to the screen and notifies user-space when it should resume.
+endchoice
+
 config HIBERNATION
 	bool "Hibernation (aka 'suspend to disk')"
 	depends on PM && SWAP && ARCH_HIBERNATION_POSSIBLE
```

## kernels/patches/vanilla/lib/Kconfig.debug.diff
```kconfig
--- ./vanilla//lib/Kconfig.debug	2010-02-23 17:38:51.000000000 +0200
+++ ./default//lib/Kconfig.debug	2012-05-23 10:44:04.755935191 +0300
@@ -545,8 +545,9 @@
 	  mutexes and rwsems.
 
 config STACKTRACE
-	bool
+	bool "Stacktrace"
 	depends on STACKTRACE_SUPPORT
+	default y
 
 config DEBUG_KOBJECT
 	bool "kobject debugging"
```

## kernels/patches/vanilla/net/Kconfig.diff
```kconfig
--- ./vanilla//net/Kconfig	2010-02-23 17:38:51.000000000 +0200
+++ ./default//net/Kconfig	2012-05-23 10:44:04.797935187 +0300
@@ -79,6 +79,12 @@
 
 endif # if INET
 
+config ANDROID_PARANOID_NETWORK
+	bool "Only allow certain groups to create sockets"
+	default y
+	help
+		none
+
 config NETWORK_SECMARK
 	bool "Security Marking"
 	help
```

## kernels/patches/vanilla/net/rfkill/Kconfig.diff
```kconfig
--- ./vanilla//net/rfkill/Kconfig	2010-02-23 17:38:51.000000000 +0200
+++ ./default//net/rfkill/Kconfig	2012-05-23 10:44:04.916935184 +0300
@@ -10,6 +10,11 @@
 	  To compile this driver as a module, choose M here: the
 	  module will be called rfkill.
 
+config RFKILL_PM
+	bool "Power off on suspend"
+	depends on RFKILL && PM
+	default y
+
 # LED trigger support
 config RFKILL_LEDS
 	bool
```

## kernels/patches/vanilla/sound/soc/Kconfig.diff
```kconfig
--- ./vanilla//sound/soc/Kconfig	2010-02-23 17:38:51.000000000 +0200
+++ ./default//sound/soc/Kconfig	2012-05-23 10:44:06.028935133 +0300
@@ -31,6 +31,7 @@
 source "sound/soc/fsl/Kconfig"
 source "sound/soc/imx/Kconfig"
 source "sound/soc/omap/Kconfig"
+source "sound/soc/msm/Kconfig"
 source "sound/soc/pxa/Kconfig"
 source "sound/soc/s3c24xx/Kconfig"
 source "sound/soc/s6000/Kconfig"
```
