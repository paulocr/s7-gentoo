## kernels/patches/vanilla/drivers/spi/Kconfig.diff
```kconfig
--- ./vanilla//drivers/spi/Kconfig	2010-02-23 17:38:51.000000000 +0200
+++ ./default//drivers/spi/Kconfig	2012-05-23 10:43:59.200935439 +0300
@@ -198,6 +198,27 @@
 	  The driver can be configured to use any SSP port and additional
 	  documentation can be found a Documentation/spi/pxa2xx.
 
+config SPI_QSD
+	tristate "Qualcomm MSM SPI support"
+	default n
+	depends on ARCH_MSM_SCORPION
+	help
+	  Support for Serial Peripheral Interface for Qualcomm MSM
+
+	  This driver can also be built as a module.  If so, the module
+	  will be called spi_qsd.
+
+config SPI_QUP
+	tristate "Qualcomm MSM SPI QUPe Support"
+	depends on ARCH_MSM8X60 && !SPI_QSD
+	default y
+	help
+	  Support for Serial Peripheral Interface for Qualcomm Universal
+          Peripheral.
+
+	  This driver can also be built as a module.  If so, the module
+	  will be called spi_qsd.
+
 config SPI_S3C24XX
 	tristate "Samsung S3C24XX series SPI"
 	depends on ARCH_S3C2410 && EXPERIMENTAL
```

## kernels/patches/vanilla/drivers/staging/android/Kconfig.diff
```kconfig
--- ./vanilla//drivers/staging/android/Kconfig	2010-02-23 17:38:51.000000000 +0200
+++ ./default//drivers/staging/android/Kconfig	2012-05-23 10:43:59.207935438 +0300
@@ -2,7 +2,6 @@
 
 config ANDROID
 	bool "Android Drivers"
-	depends on BROKEN
 	default N
 	---help---
 	  Enable support for various drivers needed on the Android platform
```

## kernels/patches/vanilla/drivers/usb/Kconfig.diff
```kconfig
--- ./vanilla//drivers/usb/Kconfig	2010-02-23 17:38:51.000000000 +0200
+++ ./default//drivers/usb/Kconfig	2012-05-23 10:43:59.563935422 +0300
@@ -60,6 +60,7 @@
 	default y if ARCH_IXP4XX
 	default y if ARCH_W90X900
 	default y if ARCH_AT91SAM9G45
+	default y if ARCH_MSM
 	default PCI
 
 # ARM SA1111 chips have a non-PCI based "OHCI-compatible" USB host interface.
@@ -157,4 +158,6 @@
 
 source "drivers/usb/otg/Kconfig"
 
+source "drivers/usb/function/Kconfig"
+
 endif # USB_SUPPORT
```

## kernels/patches/vanilla/drivers/usb/gadget/Kconfig.diff
```kconfig
--- ./vanilla//drivers/usb/gadget/Kconfig	2010-02-23 17:38:51.000000000 +0200
+++ ./default//drivers/usb/gadget/Kconfig	2012-05-23 10:43:59.575935422 +0300
@@ -99,6 +99,13 @@
 config	USB_GADGET_SELECTED
 	boolean
 
+config  USB_AUTO_INSTALL
+	 boolean "Enable the ADB auto reactivate feature"
+	 help
+		For CTS test, query adb is active or not every 5 seconds.
+		reactivate it if not active.
+		
+
 #
 # USB Peripheral Controller Support
 #
@@ -509,6 +516,25 @@
 # LAST -- dummy/emulated controller
 #
 
+config USB_GADGET_MSM_72K
+	boolean "MSM 72K Device Controller"
+	depends on ARCH_MSM
+	select USB_GADGET_SELECTED
+	select USB_GADGET_DUALSPEED
+	select USB_OTG if USB_EHCI_MSM && PM
+	help
+	   USB gadget driver for Qualcomm MSM 72K architecture.
+
+	   Say "y" to link the driver statically, or "m" to build a
+	   dynamically linked module called "msm72k" and force all
+	   gadget drivers to also be dynamically linked.
+
+config USB_MSM_72K
+	tristate
+	depends on USB_GADGET_MSM_72K
+	default USB_GADGET
+	select USB_GADGET_SELECTED
+
 config USB_GADGET_DUMMY_HCD
 	boolean "Dummy HCD (DEVELOPMENT)"
 	depends on USB=y || (USB=m && USB_GADGET=m)
@@ -780,6 +806,105 @@
 	  For more information, see Documentation/usb/gadget_printer.txt
 	  which includes sample code for accessing the device file.
 
+config USB_ANDROID
+	tristate "Android Gadget"
+	help
+	  The Android gadget provides mass storage and adb transport.
+
+	  Say "y" to link the driver statically, or "m" to build a
+	  dynamically linked module called "g_android".
+
+config USB_ANDROID_DIAG
+	tristate "diag function driver"
+	depends on USB_ANDROID
+	default n
+	help
+	  Say "y" to link the driver statically, or "m" to build
+	  as a part of "g_android"
+
+config USB_ANDROID_CDC_ECM
+	tristate "cdc ecm function driver"
+	depends on USB_ANDROID
+	default n
+	help
+	  enabling this option adds CDC-ECM support to the
+	  android gadget.
+	  Say "y" to link the CDC-ECM as a part of android gadget
+
+config USB_ANDROID_RNDIS
+	bool "RNDIS function driver"
+	depends on USB_ANDROID
+	default n
+	help
+	  enabling this option adds RNDIS support to the
+	  android gadget.
+
+config USB_ANDROID_RNDIS_WCEIS
+	boolean "Use Windows Internet Sharing Class/SubClass/Protocol"
+	depends on USB_ANDROID_RNDIS
+	default n
+	help
+	 Causes the driver to look like a Windows-compatible Internet
+	 Sharing device, so Windows auto-detects it
+
+	 If you enable this option, the device is no longer CDC ethernet
+	 compatible.
+
+config USB_ANDROID_RMNET
+	bool "RmNet function driver"
+	depends on USB_ANDROID
+	default n
+	help
+	  Enabling this option adds rmnet support to the
+	  android gadget. Rmnet is an alternative to CDC-ECM
+	  and Windows RNDIS. It uses QUALCOMM MSM Interface
+	  for control transfers. It acts like a bridge between
+	  Host and modem found in MSM chipsets.
+
+config RMNET_SMD_CTL_CHANNEL
+	string "control SMD channel name"
+	depends on USB_ANDROID_RMNET
+	default ""
+	help
+	  Control SMD channel for transferring QMI messages
+
+config RMNET_SMD_DATA_CHANNEL
+	string "Data SMD channel name"
+	depends on USB_ANDROID_RMNET
+	default ""
+	help
+	  Data SMD channel for transferring network data
+
+config USB_F_SERIAL
+	tristate "generic serial function driver"
+	depends on USB_ANDROID
+	default n
+	help
+	  Say "y" to link the driver statically, or "m" to build
+	  as a part of "g_android"
+
+config MODEM_SUPPORT
+	tristate "modem support in generic serial function driver"
+	depends on USB_F_SERIAL
+	default n
+	help
+          This feature enables the modem functionality in the
+	  generic serial.
+	  adds interrupt endpoint support to send modem notifications
+	  to host.
+	  adds CDC descriptors to enumerate the generic serial as MODEM.
+	  adds CDC class requests to configure MODEM line settings.
+	  Say "y" to enable MODEM support in the generic serial driver.
+
+config USB_CSW_HACK
+	boolean "USB Mass storage csw hack Feature"
+	depends on USB_ANDROID
+	help
+	 This csw hack feature is for increasing the performance of the mass
+	 storage
+
+	default y
+
 config USB_CDC_COMPOSITE
 	tristate "CDC Composite Device (Ethernet and ACM)"
 	depends on NET
```
