## kernels/patches/vanilla/drivers/input/touchscreen/Kconfig.diff
```kconfig
--- ./vanilla//drivers/input/touchscreen/Kconfig	2010-02-23 17:38:51.000000000 +0200
+++ ./default//drivers/input/touchscreen/Kconfig	2012-05-23 10:43:57.811935501 +0300
@@ -4,7 +4,7 @@
 menuconfig INPUT_TOUCHSCREEN
 	bool "Touchscreens"
 	help
-	  Say Y here, and a list of supported touchscreens will be displayed.
+	  Say Y here, and a list of supported touchscreens will be displayed. 
 	  This option doesn't affect the kernel.
 
 	  If unsure, say Y.
@@ -103,6 +103,17 @@
 	  NOTE: this driver is deprecated, try enable SPI and generic
 	  ADS7846-based touchscreen driver.
 
+config TOUCHSCREEN_CYPRESS_TMG
+	tristate "Support for Cypress TMC i2c touchscreen"
+	depends on I2C
+	help
+	  Say Y here to enable support for cy8ctmg touchcreens.
+
+	  If unsure, say N
+
+	  To compile this driver as a module, choose M here: the
+	  module will be called h3600_ts_input.
+
 config TOUCHSCREEN_DA9034
 	tristate "Touchscreen support for Dialog Semiconductor DA9034"
 	depends on PMIC_DA903X
@@ -145,6 +156,10 @@
 	  To compile this driver as a module, choose M here: the
 	  module will be called gunze.
 
+config TOUCHSCREEN_ELAN_I2C_8232
+	tristate "Elan 8232 I2C touchscreen"
+	depends on I2C
+
 config TOUCHSCREEN_ELO
 	tristate "Elo serial touchscreens"
 	select SERIO
@@ -260,6 +275,15 @@
 	  To compile this driver as a module, choose M here: the
 	  module will be called penmount.
 
+config TOUCHSCREEN_MSM
+	bool "Qualcomm MSM touchscreen controller"
+	depends on ARCH_MSM7X30 && MARIMBA_TSADC
+	default n
+	help
+	  Say Y here if you have a 4-wire resistive touchscreen panel
+	  connected to the TSSC touchscreen controller on a
+	  Qualcomm MSM/QSD based SoC.
+
 config TOUCHSCREEN_MIGOR
 	tristate "Renesas MIGO-R touchscreen"
 	depends on SH_MIGOR && I2C
@@ -271,6 +295,40 @@
 	  To compile this driver as a module, choose M here: the
 	  module will be called migor_ts.
 
+config TOUCHSCREEN_T1320
+	tristate "T1320 Capacitive Touchscreen"
+	depends on I2C
+	help
+	  This enables support for T1320 based touchscreens.
+
+config SYNA_BUTTONS
+	bool "T1320 buttons (reported as buttons)"
+	depends on TOUCHSCREEN_T1320
+
+config SYNA_BUTTONS_SCROLL
+	bool "T1320 buttons reported as relative motion (scroll strip)"
+	depends on TOUCHSCREEN_T1320
+
+config SYNA_MOUSE
+	bool "T1320 pointing compatible with old single-point touch systems"
+	depends on TOUCHSCREEN_T1320
+
+config SYNA_MT
+	bool "T1320 pointing using Linux 2.6.31 multi-touch system"
+	depends on TOUCHSCREEN_T1320
+
+config UPDATE_TS_FIRMWARE
+	bool "Surport download t1320 firmware function"
+	depends on TOUCHSCREEN_T1320
+config TOUCHSCREEN_MXT224
+	tristate "mXT224 based touchscreens"
+	depends on I2C
+	help
+	  Say Y here if you have a mXT224 based touchscreen.
+	  If unsure, say N.
+	  To compile this driver as a module, choose M here: the
+	  module will be called mxt224
+
 config TOUCHSCREEN_TOUCHRIGHT
 	tristate "Touchright serial touchscreen"
 	select SERIO
@@ -512,6 +570,27 @@
 	  To compile this driver as a module, choose M here: the
 	  module will be called tsc2007.
 
+config TOUCHSCREEN_MSM_LEGACY
+	default n
+	tristate "MSM Touchscreen"
+	depends on ARCH_MSM && !ARCH_MSM7X30
+	help
+	  Say Y here if you have a touchscreen interface using MSM
+	  touchscreen controller.
+
+	  To compile this driver as a module, choose M here: the
+	  module will be called msm_touch.
+
+config ANDROID_TOUCHSCREEN_MSM_HACKS
+	default y
+	depends on TOUCHSCREEN_MSM_LEGACY
+	bool "Android MSM Touchscreen hacks"
+	help
+	  Say Y here if you are running Android framework on Qualcomm
+	  MSM/QSD based Surf or FFAs. These hacks are required inorder
+	  to Android framework to receive adjusted x, y co-ordinates
+	  until proper calibration framework is in place.
+
 config TOUCHSCREEN_W90X900
 	tristate "W90P910 touchscreen driver"
 	depends on HAVE_CLK
@@ -530,4 +609,19 @@
 
 	  To compile this driver as a module, choose M here: the
 	  module will be called pcap_ts.
+
+config TOUCHSCREEN_CY8C_TS
+	tristate "Cypress TMA300-TMG200 based touchscreens"
+	depends on I2C
+	default n
+	help
+	  Say Y here if you have a Cypress TMA300/TMG200 based touchscreen.
+	  TMA300 is a multi-touch screen which can report upto 10
+	  touches at a time. TMG200 supports 2 touches.
+
+	  If unsure, say N.
+
+	  To compile this driver as a module, choose M here: the
+	  module will be called cy8c_ts.
+
 endif
```

## kernels/patches/vanilla/drivers/leds/Kconfig.diff
```kconfig
--- ./vanilla//drivers/leds/Kconfig	2010-02-23 17:38:51.000000000 +0200
+++ ./default//drivers/leds/Kconfig	2012-05-23 10:43:57.867935497 +0300
@@ -157,6 +157,13 @@
 	  To compile this driver as a module, choose M here: the
 	  module will be called leds-lp3944.
 
+config LEDS_CPLD
+	tristate "LED Support for CPLD connected LEDs"
+	default y
+	depends on LEDS_CLASS
+	help
+	  This option enables support for the LEDs connected to CPLD
+
 config LEDS_CLEVO_MAIL
 	tristate "Mail LED on Clevo notebook"
 	depends on LEDS_CLASS && X86 && SERIO_I8042 && DMI
@@ -236,6 +243,24 @@
 	  This option enables support for BD2802GU RGB LED driver chips
 	  accessed via the I2C bus.
 
+config LEDS_MSM_PMIC
+        tristate "LED Support for Qualcomm PMIC connected LEDs"
+        default y
+        depends on LEDS_CLASS && ARCH_MSM
+        help
+          This option enables support for LEDs connected over PMIC
+          (Power Management IC) chip on Qualcomm reference boards,
+          for example SURF and FFAs.
+
+config LEDS_PMIC8058
+	tristate "LED Support for Qualcomm PMIC8058"
+	default n
+	depends on LEDS_CLASS && PMIC8058
+	help
+	  This option enables support for LEDs connected over PMIC8058
+	  (Power Management IC) chip on Qualcomm reference boards,
+	  for example SURF and FFAs.
+
 comment "LED Triggers"
 
 config LEDS_TRIGGERS
@@ -301,7 +326,25 @@
 	  This allows LEDs to be initialised in the ON state.
 	  If unsure, say Y.
 
+config LEDS_TRIGGER_SLEEP
+	tristate "LED Sleep Mode Trigger"
+	depends on LEDS_TRIGGERS && HAS_EARLYSUSPEND
+	help
+	  This turns LEDs on when the screen is off but the cpu still running.
+
 comment "iptables trigger is under Netfilter config (LED target)"
 	depends on LEDS_TRIGGERS
 
+config HUAWEI_LEDS_BASE
+	tristate "LED support for Huawei interface base LEDs"
+	depends on MACH_QSD8X50_SURF_S70
+	help
+	  MSM/QSD LED controller of interface base(HDMI LED/CVBS LED).
+
+config HUAWEI_INCIDENT_LED_NEW
+       tristate "Incident LED support for Huawei(NEW)"
+       depends on MACH_QSD8X50_SURF_S70
+       help
+	Support for Huawei Incident LED. 
+
 endif # NEW_LEDS
```

## kernels/patches/vanilla/drivers/mfd/Kconfig.diff
```kconfig
--- ./vanilla//drivers/mfd/Kconfig	2010-02-23 17:38:51.000000000 +0200
+++ ./default//drivers/mfd/Kconfig	2012-05-23 10:43:58.080935489 +0300
@@ -84,6 +84,38 @@
 	  This driver can also be built as a module.  If so, the module
 	  will be called tps65010.
 
+config TPS65023
+        tristate "TPS65023 Power Management chip"
+        depends on I2C && ARCH_MSM_SCORPION
+        default y if I2C && ARCH_MSM_SCORPION
+        help
+          Say yes here for Qualcomm QSD chips. The TI PMIC is used by the
+          QSD8x50 series of chips for power management.
+
+config PMIC8058
+	tristate "PMIC8058 Power Management chip"
+	depends on I2C_SSBI && (ARCH_MSM7X30 || ARCH_MSM8X60)
+	default y if I2C_SSBI && (ARCH_MSM7X30 || ARCH_MSM8X60)
+	select MFD_CORE
+	help
+	  Say yes here for Qualcomm PM8058 chip.
+
+config PMIC8901
+	tristate "PMIC8901 Power Management chip"
+	depends on I2C_SSBI && ARCH_MSM8X60
+	default y if I2C_SSBI && ARCH_MSM8X60
+	select MFD_CORE
+	help
+	  Say yes here for Qualcomm PM8901 chip.
+
+config MARIMBA_TSADC
+	tristate "Support for Marimba Touchscreen ADC"
+	depends on MARIMBA_CORE
+	default y if MARIMBA_CORE
+	help
+	  Say yes here if you want to include support for TSADC in the
+	  Qualcomm Marimba chip.
+
 config MENELAUS
 	bool "Texas Instruments TWL92330/Menelaus PM chip"
 	depends on I2C=y && ARCH_OMAP24XX
@@ -108,6 +140,23 @@
 	  high speed USB OTG transceiver, an audio codec (on most
 	  versions) and many other features.
 
+config MARIMBA_CORE
+	tristate "Marimba Core"
+	depends on I2C && ARCH_MSM7X30
+	default n
+	help
+	  Enables the Marimba Core driver. The core driver provides
+	  read/write capability to registers which are part of the
+	  marimba core.
+
+config MARIMBA_CODEC
+	tristate "Marimba Codec"
+	depends on MARIMBA_CORE
+	default n
+	help
+	 This driver programs Marimba Wideband Codec for input/output of
+	 audio signal.
+
 config TWL4030_POWER
 	bool "Support power resources on TWL4030 family chips"
 	depends on TWL4030_CORE && ARM
```

## kernels/patches/vanilla/drivers/misc/Kconfig.diff
```kconfig
--- ./vanilla//drivers/misc/Kconfig	2010-02-23 17:38:51.000000000 +0200
+++ ./default//drivers/misc/Kconfig	2012-05-23 10:43:58.086935488 +0300
@@ -13,6 +13,20 @@
 
 if MISC_DEVICES
 
+config ANDROID_PMEM
+	bool "Android pmem allocator"
+	default y
+
+config ANDROID_PMEM_DEBUG
+	bool "Android pmem debug"
+	depends on ANDROID_PMEM
+	default n
+
+config ANDROID_PMEM_KAPI_TEST
+	tristate "Simple module to test Android pmem kernel API"
+	depends on ANDROID_PMEM
+	default m
+
 config ATMEL_PWM
 	tristate "Atmel AT32/AT91 PWM support"
 	depends on AVR32 || ARCH_AT91SAM9263 || ARCH_AT91SAM9RL || ARCH_AT91CAP9
@@ -159,6 +173,13 @@
 	  driver (SCSI/ATA) which supports enclosures
 	  or a SCSI enclosure device (SES) to use these services.
 
+config KERNEL_DEBUGGER_CORE
+	bool "Kernel Debugger Core"
+	default n
+	---help---
+	  Generic kernel debugging command processor used by low level
+	  (interrupt context) platform-specific debuggers.
+
 config SGI_XP
 	tristate "Support communication between SGI SSIs"
 	depends on NET
@@ -246,8 +267,102 @@
 	  To compile this driver as a module, choose M here: the module will
 	  be called ep93xx_pwm.
 
+config UID_STAT
+	bool "UID based statistics tracking exported to /proc/uid_stat"
+	default n
+
+config WL127X_RFKILL
+	tristate "Bluetooth power control driver for TI wl127x"
+	depends on RFKILL
+	default n
+	---help---
+	 Creates an rfkill entry in sysfs for power control of Bluetooth
+	 TI wl127x chips.
+
+config APANIC
+	bool "Android kernel panic diagnostics driver"
+	default n
+	---help---
+	 Driver which handles kernel panics and attempts to write
+	 critical debugging data to flash.
+
+config APANIC_PLABEL
+	string "Android panic dump flash partition label"
+	depends on APANIC
+	default "kpanic"
+	---help---
+	 If your platform uses a different flash partition label for storing
+ 	 crashdumps, enter it here.
+
+config TSIF
+	depends on ARCH_MSM
+	tristate "TSIF (Transport Stream InterFace) support"
+	default n
+	---help---
+	  This driver supports low level TSIF interface. It provides API
+	  for upper layer drivers. If you have a TSIF hardware, say
+	  Y here and read <file:Documentation/arm/msm/tsif.txt>.
+
+	  To compile this driver as module, choose M here: the
+	  module will be called msm_tsif.
+
+config TSIF_CHRDEV
+	tristate "TSIF character device"
+	depends on TSIF
+	default n
+	---help---
+	  This driver uses low level TSIF interface. It provides character
+	  device useable from user space programs: one can read TSIF stream
+	  from this device.
+
+	  This driver may be used as example for TSIF API usage.
+
+	  To compile this driver as module, choose M here: the
+	  module will be called tsif_chrdev.
+
+config TSIF_DEBUG
+	bool "Turn on debugging information for tsif driver"
+	depends on TSIF
+	default n
+	---help---
+	  This turns on debugging information for the tsif driver
+
+config PMIC8058_PWM
+	tristate "Qualcomm PM8058 PWM support"
+	depends on PMIC8058
+	default y
+	help
+	  This option enables device driver support for the PWM channels
+	  on Qualcomm PM8058 chip. Pulse Width Modulation is used for
+	  purposes including software controlled brightness of backlight,
+	  motor control, and waveform generation.
+
+config HAPTIC_ISA1200
+	tristate "ISA1200 haptic support"
+	depends on I2C
+	default n
+	help
+	  The ISA1200 is a high performance enhanced haptic driver.
+
+config PMIC8058_VIBRATOR
+	tristate "Qualcomm PM8058 vibrator support"
+	depends on PMIC8058 && ANDROID_TIMED_OUTPUT
+	default n
+	help
+	  This option enables device driver support for the vibrator
+	  on Qualcomm PM8058 chip.
+
+config PMIC8058_NFC
+	tristate "Qualcomm PM8058 support for Near Field Communication"
+	depends on PMIC8058
+	default y
+	help
+	  Qualcomm PM8058 chip has a module to support NFC (Near Field
+	  Communication). This option enables the driver to support it.
+
 source "drivers/misc/c2port/Kconfig"
 source "drivers/misc/eeprom/Kconfig"
 source "drivers/misc/cb710/Kconfig"
+source "drivers/misc/vidc/Kconfig"
 
 endif # MISC_DEVICES
```

## kernels/patches/vanilla/drivers/mmc/Kconfig.diff
```kconfig
--- ./vanilla//drivers/mmc/Kconfig	2010-02-23 17:38:51.000000000 +0200
+++ ./default//drivers/mmc/Kconfig	2012-05-23 10:43:58.154935485 +0300
@@ -19,6 +19,14 @@
 	  This is an option for use by developers; most people should
 	  say N here.  This enables MMC core and driver debugging.
 
+config MMC_PERF_PROFILING
+	bool "MMC performance profiling"
+	depends on MMC != n
+	default n
+	help
+	  If you say Y here, support will be added for collecting
+	  performance numbers at the MMC Queue and Host layers.
+
 if MMC
 
 source "drivers/mmc/core/Kconfig"
```

## kernels/patches/vanilla/drivers/mmc/card/Kconfig.diff
```kconfig
--- ./vanilla//drivers/mmc/card/Kconfig	2010-02-23 17:38:51.000000000 +0200
+++ ./default//drivers/mmc/card/Kconfig	2012-05-23 10:43:58.154935485 +0300
@@ -32,6 +32,15 @@
 
 	  If unsure, say Y here.
 
+config MMC_BLOCK_DEFERRED_RESUME
+	bool "Deferr MMC layer resume until I/O is requested"
+	depends on MMC_BLOCK
+	default n
+	help
+	  Say Y here to enable deferred MMC resume until I/O
+	  is requested. This will reduce overall resume latency and
+	  save power when theres an SD card inserted but not being used.
+
 config SDIO_UART
 	tristate "SDIO UART/GPS class support"
 	help
```
