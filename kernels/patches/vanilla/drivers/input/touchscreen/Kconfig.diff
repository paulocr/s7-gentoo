## kernels/patches/vanilla/drivers/mmc/host/Kconfig.diff
```kconfig
--- ./vanilla//drivers/mmc/host/Kconfig	2010-02-23 17:38:51.000000000 +0200
+++ ./default//drivers/mmc/host/Kconfig	2012-05-23 10:43:58.157935483 +0300
@@ -207,13 +207,6 @@
 
 	  If unsure, say N.
 
-config MMC_MSM7X00A
-	tristate "Qualcomm MSM 7X00A SDCC Controller Support"
-	depends on MMC && ARCH_MSM
-	help
-	  This provides support for the SD/MMC cell found in the
-          MSM 7X00A controllers from Qualcomm.
-
 config MMC_MXC
 	tristate "Freescale i.MX2/3 Multimedia Card Interface support"
 	depends on ARCH_MXC
@@ -327,6 +320,160 @@
 	  To compile this driver as a module, choose M here: the
 	  module will be called sdricoh_cs.
 
+
+config MMC_MSM
+	tristate "Qualcomm SDCC Controller Support"
+	depends on MMC && ARCH_MSM
+	help
+	  This provides support for the SD/MMC cell found in the
+          MSM and QSD SOCs from Qualcomm.
+
+config MMC_MSM_NOT_REMOVE_CARD_WHEN_SUSPEND
+	bool "Do not remove card when suspending"
+    depends on MMC_MSM && PM
+	default y
+	help
+	  This always keeps power of Qualcomm SDCC controller on and
+	  does not remove card when entering into suspend.
+
+
+config MMC_MSM_SDIO_SUPPORT
+	boolean "Qualcomm MSM SDIO support"
+	depends on MMC_MSM
+	help
+	  This enables SDIO support in the msm_sdcc driver.
+
+config MMC_MSM_CARD_HW_DETECTION
+	boolean "Qualcomm MMC Hardware detection support"
+	depends on MMC_MSM
+	default n
+	help
+	  Select Y if the hardware has support to detect card insertion/removal.
+
+config MMC_MSM_SDC1_SUPPORT
+	boolean "Qualcomm SDC1 support"
+	depends on MMC_MSM
+	default y
+	help
+	  Select Y to enable Slot 1.
+
+config MMC_MSM_SDC1_8_BIT_SUPPORT
+	boolean "Qualcomm SDC1 8bit support"
+	depends on MMC_MSM_SDC1_SUPPORT
+	default n
+	help
+	  Select Y to enable 8bit support for Slot 1.
+
+config MMC_MSM_SDC1_DUMMY52_REQUIRED
+	boolean "Send dummy 52 read for SDC1"
+	depends on MMC_MSM_SDC1_SUPPORT && !MMC_MSM_PROG_DONE_SCAN
+	default n
+	help
+	  Select Y to enable sending dummy 52 reads to complete
+	  all data commands.  Required for some SDIO cards.
+	  If unsure, say N.
+
+config MMC_MSM_SDC2_SUPPORT
+	boolean "Qualcomm SDC2 support"
+	depends on MMC_MSM
+	default y
+	help
+	  Select Y to enable Slot 2.
+
+config MMC_MSM_SDC2_8_BIT_SUPPORT
+	boolean "Qualcomm SDC2 8bit support"
+	depends on MMC_MSM_SDC2_SUPPORT
+	default n
+	help
+	  Select Y to enable 8bit support for Slot 2.
+
+config MMC_MSM_SDC2_DUMMY52_REQUIRED
+	boolean "Send dummy 52 read for SDC2"
+	depends on MMC_MSM_SDC2_SUPPORT && !MMC_MSM_PROG_DONE_SCAN
+	default n
+	help
+	  Select Y to enable sending dummy 52 reads to complete
+	  all data commands.  Required for some SDIO cards.
+	  If unsure, say N.
+
+config MMC_MSM_SDC3_SUPPORT
+	boolean "Qualcomm SDC3 support"
+	depends on MMC_MSM
+	default n
+	help
+	  Select Y to enable Slot 3.
+
+config MMC_MSM_SDC3_8_BIT_SUPPORT
+	boolean "Qualcomm SDC3 8bit support"
+	depends on MMC_MSM_SDC3_SUPPORT
+	default n
+	help
+	  Select Y to enable 8bit support for Slot 3.
+
+config MMC_MSM_SDC3_DUMMY52_REQUIRED
+	boolean "Send dummy 52 read for SDC3"
+	depends on MMC_MSM_SDC3_SUPPORT && !MMC_MSM_PROG_DONE_SCAN
+	default n
+	help
+	  Select Y to enable sending dummy 52 reads to complete
+	  all data commands.  Required for some SDIO cards.
+	  If unsure, say N.
+
+config MMC_MSM_SDC4_SUPPORT
+	boolean "Qualcomm SDC4 support"
+	depends on MMC_MSM
+	default n
+	help
+	  Select Y to enable Slot 4.
+
+config MMC_MSM_SDC4_8_BIT_SUPPORT
+	boolean "Qualcomm SDC4 8bit support"
+	depends on MMC_MSM_SDC4_SUPPORT
+	default n
+	help
+	  Select Y to enable 8bit support for Slot 4.
+
+config MMC_MSM_SDC4_DUMMY52_REQUIRED
+	boolean "Send dummy 52 read for SDC4"
+	depends on MMC_MSM_SDC4_SUPPORT && !MMC_MSM_PROG_DONE_SCAN
+	default n
+	help
+	  Select Y to enable sending dummy 52 reads to complete
+	  all data commands.  Required for some SDIO cards.
+	  If unsure, say N.
+
+config MMC_MSM_SDC5_SUPPORT
+	boolean "Qualcomm SDC5 support"
+	depends on MMC_MSM
+	default n
+	help
+	  Select Y to enable Slot 5.
+
+config MMC_MSM_SDC5_8_BIT_SUPPORT
+	boolean "Qualcomm SDC5 8bit support"
+	depends on MMC_MSM_SDC5_SUPPORT
+	default n
+	help
+	  Select Y to enable 8bit support for Slot 5.
+
+config MMC_MSM_SDC5_DUMMY52_REQUIRED
+	boolean "Send dummy 52 read for SDC5"
+	depends on MMC_MSM_SDC5_SUPPORT && !MMC_MSM_PROG_DONE_SCAN
+	default n
+	help
+	  Select Y to enable sending dummy 52 reads to complete
+	  all data commands.  Required for some SDIO cards.
+	  If unsure, say N.
+
+config MMC_MSM_PROG_DONE_SCAN
+	bool "Perform prog done scan as needed for SDIO"
+	depends on MMC_MSM
+	default n
+	help
+	  Enable prog_done scan after cmd53-dummycmd52 for SDIO
+
+
+
 config MMC_TMIO
 	tristate "Toshiba Mobile IO Controller (TMIO) MMC/SD function support"
 	depends on MFD_TMIO || MFD_ASIC3
```

## kernels/patches/vanilla/drivers/mtd/Kconfig.diff
```kconfig
--- ./vanilla//drivers/mtd/Kconfig	2010-02-23 17:38:51.000000000 +0200
+++ ./default//drivers/mtd/Kconfig	2012-05-23 10:43:58.164935485 +0300
@@ -53,6 +53,18 @@
 	  devices. Partitioning on NFTL 'devices' is a different - that's the
 	  'normal' form of partitioning used on a block device.
 
+config MTD_LAZYECCSTATS
+	bool "MTD Lazy ECC Stats collection support"
+	depends on MTD_PARTITIONS
+	default n
+	help
+	  Normally bad block counts for ECC stats are collected at boot time.
+	  This option delays the badblock stats collection until ECCGETSTATS
+	  ioctl is invoked on the partition.
+
+	  This can significantly decrease boot times depending on the size of
+	  the partition.  If unsure, say 'N'.
+
 config MTD_REDBOOT_PARTS
 	tristate "RedBoot partition table parsing"
 	depends on MTD_PARTITIONS
```

## kernels/patches/vanilla/drivers/mtd/devices/Kconfig.diff
```kconfig
--- ./vanilla//drivers/mtd/devices/Kconfig	2010-02-23 17:38:51.000000000 +0200
+++ ./default//drivers/mtd/devices/Kconfig	2012-05-23 10:43:58.167935485 +0300
@@ -51,6 +51,16 @@
 	  say M here and read <file:Documentation/kbuild/modules.txt>.
 	  The module will be called ms02-nv.
 
+config MTD_MSM_NAND
+	tristate "MSM NAND Device Support"
+	depends on MTD && ARCH_MSM
+	select CRC16
+	select BITREVERSE
+	select MTD_NAND_IDS
+	default y
+	help
+	  Support for some NAND chips connected to the MSM NAND controller.
+
 config MTD_DATAFLASH
 	tristate "Support for AT45xxx DataFlash"
 	depends on SPI_MASTER && EXPERIMENTAL
```

## kernels/patches/vanilla/drivers/mtd/nand/Kconfig.diff
```kconfig
--- ./vanilla//drivers/mtd/nand/Kconfig	2010-02-23 17:38:51.000000000 +0200
+++ ./default//drivers/mtd/nand/Kconfig	2012-05-23 10:43:58.182935484 +0300
@@ -1,5 +1,12 @@
 # drivers/mtd/nand/Kconfig
 
+config MTD_NAND_IDS
+	tristate "Include chip ids for known NAND devices."
+	depends on MTD
+	help
+	  Useful for NAND drivers that do not use the NAND subsystem but
+	  still like to take advantage of the known chip information.
+
 menuconfig MTD_NAND
 	tristate "NAND Device Support"
 	depends on MTD
@@ -103,9 +110,6 @@
 	help
 	  Support for NAND flash on Technologic Systems TS-7250 platform.
 
-config MTD_NAND_IDS
-	tristate
-
 config MTD_NAND_AU1550
 	tristate "Au1550/1200 NAND support"
 	depends on SOC_AU1200 || SOC_AU1550
```

## kernels/patches/vanilla/drivers/net/Kconfig.diff
```kconfig
--- ./vanilla//drivers/net/Kconfig	2010-02-23 17:38:51.000000000 +0200
+++ ./default//drivers/net/Kconfig	2012-05-23 10:43:58.204935483 +0300
@@ -3113,6 +3113,23 @@
 	  and session setup). One such daemon is OpenL2TP
 	  (http://openl2tp.sourceforge.net/).
 
+config PPPOLAC
+	tristate "PPP on L2TP Access Concentrator"
+	depends on PPP && INET
+	help
+	  L2TP (RFC 2661) is a tunneling protocol widely used in virtual private
+	  networks. This driver handles L2TP data packets between a UDP socket
+	  and a PPP channel, but only permits one session per socket. Thus it is
+	  fairly simple and suited for clients.
+
+config PPPOPNS
+	tristate "PPP on PPTP Network Server"
+	depends on PPP && INET
+	help
+	  PPTP (RFC 2637) is a tunneling protocol widely used in virtual private
+	  networks. This driver handles PPTP data packets between a RAW socket
+	  and a PPP channel. It is fairly simple and easy to use.
+
 config SLIP
 	tristate "SLIP (serial line) support"
 	---help---
@@ -3205,6 +3222,28 @@
 	If you want to log kernel messages over the network, enable this.
 	See <file:Documentation/networking/netconsole.txt> for details.
 
+config MSM_RMNET
+	tristate "MSM RMNET Virtual Network Device"
+	depends on ARCH_MSM
+	default y
+	help
+	  Virtual ethernet interface for MSM RMNET transport.
+
+config MSM_RMNET_SDIO
+	bool "RMNET SDIO Driver"
+	depends on MSM_SDIO_AL
+	default y
+	help
+	  Implements RMNET over SDIO interface.
+
+config MSM_RMNET_DEBUG
+	bool "MSM RMNET debug interface"
+	depends on MSM_RMNET
+	default n
+	help
+	  Debug stats on wakeup counts.
+
+
 config NETCONSOLE_DYNAMIC
 	bool "Dynamic reconfiguration of logging targets (EXPERIMENTAL)"
 	depends on NETCONSOLE && SYSFS && EXPERIMENTAL
```

## kernels/patches/vanilla/drivers/net/wireless/Kconfig.diff
```kconfig
--- ./vanilla//drivers/net/wireless/Kconfig	2010-02-23 17:38:51.000000000 +0200
+++ ./default//drivers/net/wireless/Kconfig	2012-05-23 10:43:58.498935470 +0300
@@ -476,6 +476,14 @@
 	  To compile this driver as a module, choose M here: the module
 	  will be called mwl8k.  If unsure, say N.
 
+config LIBRA_SDIOIF
+	tristate "Qualcomm libra wlan SDIO driver"
+	depends on MMC_MSM
+	default m
+	---help---
+	  A driver for Qualcomm WLAN SDIO Libra chipset.
+
+
 source "drivers/net/wireless/p54/Kconfig"
 source "drivers/net/wireless/ath/Kconfig"
 source "drivers/net/wireless/ipw2x00/Kconfig"
@@ -488,5 +496,6 @@
 source "drivers/net/wireless/orinoco/Kconfig"
 source "drivers/net/wireless/wl12xx/Kconfig"
 source "drivers/net/wireless/iwmc3200wifi/Kconfig"
+source "drivers/net/wireless/bcm4329/Kconfig"
 
 endif # WLAN
```

## kernels/patches/vanilla/drivers/power/Kconfig.diff
```kconfig
--- ./vanilla//drivers/power/Kconfig	2010-02-23 17:38:51.000000000 +0200
+++ ./default//drivers/power/Kconfig	2012-05-23 10:43:58.737935459 +0300
@@ -57,6 +57,12 @@
 	  Say Y here to enable support for the DS2782 standalone battery
 	  gas-gauge.
 
+config BATTERY_DS2784
+	tristate "DS2784 battery driver "
+	select W1
+	help
+	  Say Y here to enable support for batteries with ds2784 chip.
+
 config BATTERY_PMU
 	tristate "Apple PMU battery"
 	depends on PPC32 && ADB_PMU
@@ -89,6 +95,12 @@
 	help
 	  Say Y here to enable support for batteries with BQ27200(I2C) chip.
 
+config BATTERY_BQ275X0
+	bool "BQ275x0 battery driver"
+	depends on I2C
+	help
+	  Say Y here to enable support for batteries with BQ275x0(I2C) chip.
+	  
 config BATTERY_DA9030
 	tristate "DA9030 battery driver"
 	depends on PMIC_DA903X
@@ -110,4 +122,25 @@
 	help
 	 Say Y to include support for NXP PCF50633 Main Battery Charger.
 
+config BATTERY_MSM
+	tristate "MSM battery"
+	depends on ARCH_MSM
+	default m
+	help
+	  Say Y to enable support for the battery in Qualcomm MSM.
+
+config BATTERY_MSM_FAKE
+	tristate "Fake MSM battery"
+	depends on ARCH_MSM && BATTERY_MSM
+	default n
+	help
+	  Say Y to bypass actual battery queries.
+
+config LIGHT_SENSOR_PO188
+	bool "Light sensor po188"
+	depends on ARCH_MSM
+	default y
+	help
+	  Say Y to enable support for light sensor for po188
+
 endif # POWER_SUPPLY
```

## kernels/patches/vanilla/drivers/rtc/Kconfig.diff
```kconfig
--- ./vanilla//drivers/rtc/Kconfig	2010-02-23 17:38:51.000000000 +0200
+++ ./default//drivers/rtc/Kconfig	2012-05-23 10:43:58.747935459 +0300
@@ -109,6 +109,24 @@
 	  clock several times per second, please enable this option
 	  only if you know that you really need it.
 
+config RTC_INTF_ALARM
+	bool "Android alarm driver"
+	depends on RTC_CLASS
+	default y
+	help
+	  Provides non-wakeup and rtc backed wakeup alarms based on rtc or
+	  elapsed realtime, and a non-wakeup alarm on the monotonic clock.
+	  Also provides an interface to set the wall time which must be used
+	  for elapsed realtime to work.
+
+config RTC_INTF_ALARM_DEV
+	bool "Android alarm device"
+	depends on RTC_INTF_ALARM
+	default y
+	help
+	  Exports the alarm interface to user-space.
+
+
 config RTC_DRV_TEST
 	tristate "Test driver/device"
 	help
@@ -576,6 +594,37 @@
 
 comment "on-CPU RTC drivers"
 
+config RTC_DRV_MSM
+	tristate "RTC on Qualcomm Chipsets"
+	depends on ARCH_MSM
+	default y
+	help
+	  RTC driver for Qualcomm chipsets
+
+
+config RTC_SECURE_TIME_SUPPORT
+        bool "Support for secure time on Qualcomm Chipsets"
+        depends on RTC_DRV_MSM = y
+        default y
+        help
+          Say yes here to have additional handle for reading secure time
+          maintained by ARM9.
+
+config RTC_ASYNC_MODEM_SUPPORT
+	bool "Support for time update on async modem boot"
+        depends on RTC_DRV_MSM && (ARCH_MSM8X60 || ARCH_QSD8X50)
+	default n
+	help
+	 Say yes here to have the system time updated if there is
+	 an asynchronous MODEM boot.
+
+config RTC_DRV_MSM7X00A
+	tristate "MSM7X00A"
+	depends on ARCH_MSM
+	default n
+	help
+	  RTC driver for Qualcomm MSM7K chipsets
+
 config RTC_DRV_OMAP
 	tristate "TI OMAP1"
 	depends on ARCH_OMAP15XX || ARCH_OMAP16XX || ARCH_OMAP730
@@ -827,4 +876,14 @@
 	  If you say Y here you will get support for the RTC found on
 	  the PCAP2 ASIC used on some Motorola phones.
 
+config RTC_PM8058
+	tristate "PMIC8058 RTC support"
+	default n
+	depends on PMIC8058
+	help
+	  Say Y here if you want support for the PMIC8058 RTC.
+
+	  To compile this driver as a module, choose M here: the
+	  module will be called pmic8058-rtc.
+
 endif # RTC_CLASS
```

## kernels/patches/vanilla/drivers/serial/Kconfig.diff
```kconfig
--- ./vanilla//drivers/serial/Kconfig	2010-02-23 17:38:51.000000000 +0200
+++ ./default//drivers/serial/Kconfig	2012-05-23 10:43:59.182935439 +0300
@@ -1337,6 +1337,52 @@
 	depends on SERIAL_MSM=y
 	select SERIAL_CORE_CONSOLE
 
+config SERIAL_MSM_CLOCK_CONTROL
+	bool "Allow tty clients to make clock requests to msm uarts."
+	depends on SERIAL_MSM=y
+	default y
+	help
+	 Provides an interface for tty clients to request the msm uart clock
+	 to be turned on or off for power savings.
+
+config SERIAL_MSM_RX_WAKEUP
+	bool "Wakeup the msm uart clock on GPIO activity."
+	depends on SERIAL_MSM_CLOCK_CONTROL
+	default n
+	help
+	 Requires SERIAL_MSM_CLOCK_CONTROL. Wake up the uart while the uart
+	 clock is off, using a wakeup GPIO.
+
+config SERIAL_MSM_HSL
+	tristate "MSM UART High Speed : Legacy mode Serial Driver"
+	depends on ARM && ARCH_MSM
+	select SERIAL_CORE
+	default n
+	help
+	  Select this module to enable MSM high speed UART driver.
+
+config SERIAL_MSM_HSL_CONSOLE
+	bool "MSM High speed serial legacy mode console support"
+	depends on SERIAL_MSM_HSL=y
+	select SERIAL_CORE_CONSOLE
+	default n
+
+config SERIAL_MSM_HS
+	tristate "MSM UART High Speed: Serial Driver"
+	depends on ARM && ARCH_MSM
+	select SERIAL_CORE
+	default n
+	help
+	  Select this module to enable MSM high speed UART driver.
+
+config SERIAL_BCM_BT_LPM
+	tristate "Broadcom Bluetooth Low Power Mode"
+	depends on ARM && ARCH_MSM
+	select SERIAL_CORE
+	default n
+	help
+	  Select this module for Broadcom Bluetooth low power management.
+
 config SERIAL_NETX
 	tristate "NetX serial port support"
 	depends on ARM && ARCH_NETX
```
