## kernels/patches/vanilla/arch/arm/Kconfig.debug.diff
```kconfig
--- ./vanilla//arch/arm/Kconfig.debug	2010-02-23 17:38:51.000000000 +0200
+++ ./default//arch/arm/Kconfig.debug	2012-05-23 10:43:53.827935677 +0300
@@ -65,7 +65,7 @@
 # These options are only for real kernel hackers who want to get their hands dirty.
 config DEBUG_LL
 	bool "Kernel low-level debugging functions"
-	depends on DEBUG_KERNEL
+	depends on DEBUG_KERNEL && !MSM_DEBUG_UART_NONE
 	help
 	  Say Y here to include definitions of printascii, printch, printhex
 	  in the kernel.  This is helpful if you are debugging code that
```

## kernels/patches/vanilla/arch/arm/Kconfig.diff
```kconfig
--- ./vanilla//arch/arm/Kconfig	2010-02-23 17:38:51.000000000 +0200
+++ ./default//arch/arm/Kconfig	2012-05-23 10:43:53.827935677 +0300
@@ -133,6 +133,9 @@
 	  and that the relevant menu configurations are displayed for
 	  it.
 
+config ARCH_HAS_CPU_IDLE_WAIT
+	bool
+
 config GENERIC_HWEIGHT
 	bool
 	default y
@@ -561,15 +564,18 @@
 	  Support for Intel/Marvell's PXA2xx/PXA3xx processor line.
 
 config ARCH_MSM
-	bool "Qualcomm MSM"
-	select CPU_V6
+	bool "Qualcomm MSM/QSD"
+	select ARCH_HAS_CPUFREQ
+	select GENERIC_GPIO
 	select GENERIC_TIME
 	select GENERIC_CLOCKEVENTS
+	select ARCH_WANT_OPTIONAL_GPIOLIB
 	help
-	  Support for Qualcomm MSM7K based systems.  This runs on the ARM11
-	  apps processor of the MSM7K and depends on a shared memory
-	  interface to the ARM9 modem processor which runs the baseband stack
-	  and controls some vital subsystems (clock and power control, etc).
+	  Support for Qualcomm MSM/QSD based systems.  This runs on the
+	  ARM11/Scorpion apps processor of the MSM/QSD and depends on a
+	  shared memory interface to the ARM9 modem processor which
+	  runs the baseband stack and controls some vital subsystems
+	  (clock and power control, etc).
 
 config ARCH_RPC
 	bool "RiscPC"
@@ -946,6 +952,18 @@
 
 source "drivers/pcmcia/Kconfig"
 
+config KSAPI
+        tristate "KSAPI support (EXPERIMENTAL)"
+	depends on ARCH_MSM_SCORPION
+	default n
+	help
+	  KSAPI: Performance monitoring tool for linux.
+	  KSAPI records performance statistics for Snapdragon linux platform.
+	  It uses the /proc FS as a means to exchange configuration data and
+	  counter statistics. It can monitor the counter statistics for
+	  Scorpion processor supported hardware performace counters on a per
+	  thread basis or AXI counters on an overall system basis.
+
 endmenu
 
 menu "Kernel Features"
@@ -955,7 +973,8 @@
 config SMP
 	bool "Symmetric Multi-Processing (EXPERIMENTAL)"
 	depends on EXPERIMENTAL && (REALVIEW_EB_ARM11MP || REALVIEW_EB_A9MP ||\
-		 MACH_REALVIEW_PB11MP || MACH_REALVIEW_PBX || ARCH_OMAP4)
+		 MACH_REALVIEW_PB11MP || MACH_REALVIEW_PBX || ARCH_OMAP4 ||\
+		 ARCH_MSM_SCORPIONMP)
 	depends on GENERIC_CLOCKEVENTS
 	select USE_GENERIC_SMP_HELPERS
 	select HAVE_ARM_SCU if (ARCH_REALVIEW || ARCH_OMAP4)
@@ -1017,6 +1036,15 @@
 	depends on SMP
 	default "4"
 
+config SMP_PARALLEL_START
+	bool "Parallel start of SMP cores"
+	depends on SMP
+	default n
+	help
+	  Say Y here if all CPUs boot to the kernel entrypoint in
+	  parallel, rather than non-master CPUs waiting to be brought
+	  out of reset into machine specific startup code.
+
 config HOTPLUG_CPU
 	bool "Support for hot-pluggable CPUs (EXPERIMENTAL)"
 	depends on SMP && HOTPLUG && EXPERIMENTAL
@@ -1027,7 +1055,7 @@
 config LOCAL_TIMERS
 	bool "Use local timer interrupts"
 	depends on SMP && (REALVIEW_EB_ARM11MP || MACH_REALVIEW_PB11MP || \
-		REALVIEW_EB_A9MP || MACH_REALVIEW_PBX || ARCH_OMAP4)
+		REALVIEW_EB_A9MP || MACH_REALVIEW_PBX || ARCH_OMAP4 || ARCH_MSM_SCORPIONMP)
 	default y
 	select HAVE_ARM_TWD if (ARCH_REALVIEW || ARCH_OMAP4)
 	help
@@ -1096,6 +1124,20 @@
 config ARCH_HAS_HOLES_MEMORYMODEL
 	bool
 
+config HOLES_IN_ZONE
+	bool "Memory map has holes ending within MAX_ORDER_NR_PAGES"
+	default n
+	depends on FLATMEM
+	help
+	  Say 'y' here if you have multiple memory banks where the bank
+	  end addresses coresponding to the holes are not MAX_ORDER_NR_PAGES
+	  aligned. Failure to enable this in those circumstances will result
+	  in the VM code assuming ownership of pages with no memmap memory
+	  allocated for them. This option could impact performance as it
+	  performs extra checks in the VM code. As alternative, consider
+	  aligning end addresses to MAX_ORDER_NR_PAGES or changing MAX_ORDER
+	  to compensate for your alignment requirements.
+
 # Discontigmem is deprecated
 config ARCH_DISCONTIGMEM_ENABLE
 	bool
@@ -1137,6 +1179,13 @@
 	depends on HIGHMEM
 	depends on !OUTER_CACHE
 
+config VMALLOC_RESERVE
+	hex "Reserved vmalloc space"
+	default 0x08000000
+	depends on MMU
+	help
+	  Reserved vmalloc space if not specified on the kernel commandline.
+
 source "mm/Kconfig"
 
 config LEDS
@@ -1411,6 +1460,14 @@
 
 endmenu
 
+config CPU_FREQ_MSM
+        bool
+        depends on CPU_FREQ && ARCH_MSM
+        default y
+        help
+          This enables the CPUFreq driver for Qualcomm CPUs.
+          If in doubt, say Y.
+
 menu "Floating point emulation"
 
 comment "At least one emulation must be selected"
```

## kernels/patches/vanilla/arch/arm/mm/Kconfig.diff
```kconfig
--- ./vanilla//arch/arm/mm/Kconfig	2010-02-23 17:38:51.000000000 +0200
+++ ./default//arch/arm/mm/Kconfig	2012-05-23 10:43:54.071935667 +0300
@@ -576,6 +576,9 @@
 config CPU_TLB_V7
 	bool
 
+config VERIFY_PERMISSION_FAULT
+	bool
+
 endif
 
 config CPU_HAS_ASID
@@ -758,7 +761,7 @@
 config CACHE_L2X0
 	bool "Enable the L2x0 outer cache controller"
 	depends on REALVIEW_EB_ARM11MP || MACH_REALVIEW_PB11MP || MACH_REALVIEW_PB1176 || \
-		   REALVIEW_EB_A9MP || ARCH_MX35 || ARCH_MX31 || MACH_REALVIEW_PBX || ARCH_NOMADIK
+		   REALVIEW_EB_A9MP || ARCH_MX35 || ARCH_MX31 || MACH_REALVIEW_PBX || ARCH_NOMADIK || MACH_MSM7X27_SURF || MACH_MSM7X27_FFA
 	default y
 	select OUTER_CACHE
 	help
@@ -776,3 +779,18 @@
 	int
 	default 6 if ARCH_OMAP3
 	default 5
+
+config VCM_MM
+	bool
+
+config VCM
+	bool "Virtual Contiguous Memory (VCM) Layer"
+	depends on MMU
+	select GENERIC_ALLOCATOR
+	select VCM_MM
+	default n
+	help
+	  Virtual Contiguous Memory layer. This is the layer that is intended to
+	  replace PMEM.
+
+	  If you don't know what this is, say N here.
```

## kernels/patches/vanilla/drivers/Kconfig.diff
```kconfig
--- ./vanilla//drivers/Kconfig	2010-02-23 17:38:51.000000000 +0200
+++ ./default//drivers/Kconfig	2012-05-23 10:43:57.387935520 +0300
@@ -90,6 +90,8 @@
 
 source "drivers/leds/Kconfig"
 
+source "drivers/switch/Kconfig"
+
 source "drivers/accessibility/Kconfig"
 
 source "drivers/infiniband/Kconfig"
@@ -113,4 +115,7 @@
 source "drivers/staging/Kconfig"
 
 source "drivers/platform/Kconfig"
+
+source "drivers/bsp_driver/Kconfig"
+
 endmenu
```

## kernels/patches/vanilla/drivers/bluetooth/Kconfig.diff
```kconfig
--- ./vanilla//drivers/bluetooth/Kconfig	2010-02-23 17:38:51.000000000 +0200
+++ ./default//drivers/bluetooth/Kconfig	2012-05-23 10:43:57.457935516 +0300
@@ -69,6 +69,17 @@
 
 	  Say Y here to compile support for HCILL protocol.
 
+config BT_HCIUART_IBS
+	bool "HCI_IBS protocol support"
+	depends on BT_HCIUART
+	default n
+	help
+	  HCI_IBS (HCI In-Band Sleep) is a serial protocol for communication
+	  between Bluetooth device and host. This protocol is required for
+	  UART clock control for some Qualcomm Bluetooth devices.
+
+	  Say Y here to compile support for HCI_IBS protocol.
+
 config BT_HCIBCM203X
 	tristate "HCI BCM203x USB driver"
 	depends on USB
@@ -92,6 +103,14 @@
 	  Say Y here to compile support for HCI BPA10x devices into the
 	  kernel or say M to compile it as module (bpa10x).
 
+config BT_MSM_SLEEP
+	tristate "MSM Bluesleep driver"
+	depends on BT && SERIAL_MSM_HS
+	default n
+	help
+	  Bluetooth MSM bluesleep driver.
+	  This driver provides support for BTS sleep.
+
 config BT_HCIBFUSB
 	tristate "HCI BlueFRITZ! USB driver"
 	depends on USB
@@ -195,5 +214,13 @@
 	  Say Y here to compile support for Marvell BT-over-SDIO driver
 	  into the kernel or say M to compile it as module.
 
+config MSM_BT_POWER
+	tristate "MSM Bluetooth Power Control"
+	depends on ARCH_MSM && RFKILL
+	default m
+	help
+	  Provides a parameter to switch on/off power from PMIC
+	  to Bluetooth device.
+
 endmenu
 
```

## kernels/patches/vanilla/drivers/char/Kconfig.diff
```kconfig
--- ./vanilla//drivers/char/Kconfig	2010-02-23 17:38:51.000000000 +0200
+++ ./default//drivers/char/Kconfig	2012-05-23 10:43:57.463935515 +0300
@@ -88,6 +88,19 @@
 	 information. For framebuffer console users, please refer to
 	 <file:Documentation/fb/fbcon.txt>.
 
+config DEVMEM
+	bool "Memory device driver"
+	default y
+	help
+	  The memory driver provides two character devices, mem and kmem, which
+	  provide access to the system's memory. The mem device is a view of
+	  physical memory, and each byte in the device corresponds to the
+	  matching physical address. The kmem device is the same as mem, but
+	  the addresses correspond to the kernel's virtual address space rather
+	  than physical memory. These devices are standard parts of a Linux
+	  system and most users should say Y here. You might say N if very
+	  security conscience or memory is tight.
+
 config DEVKMEM
 	bool "/dev/kmem virtual device support"
 	default y
@@ -433,6 +446,8 @@
 
 source "drivers/serial/Kconfig"
 
+source "drivers/char/diag/Kconfig"
+
 config UNIX98_PTYS
 	bool "Unix98 PTY support" if EMBEDDED
 	default y
@@ -1116,7 +1131,29 @@
 	depends on ISA || PCI
 	default y
 
+config DCC_TTY
+	tristate "DCC tty driver"
+	depends on ARM
+
 source "drivers/s390/char/Kconfig"
 
+config MSM_ROTATOR
+	tristate "MSM Offline Image Rotator Driver"
+	depends on ARCH_MSM7X30 && ANDROID_PMEM
+	default y
+	help
+	  This driver provides support for the image rotator HW block in the
+	  MSM 7x30 SoC.
+
+config MSM_ROTATOR_USE_IMEM
+	bool "Enable rotator driver to use iMem"
+	depends on MSM_ROTATOR
+	default y
+	help
+	  This option enables the msm_rotator driver to use the move efficient
+	  iMem.  Some MSM platforms may not have iMem available for the rotator
+	  block.  Or some systems may want the iMem to be dedicated to a
+	  different function.
+
 endmenu
 
```

## kernels/patches/vanilla/drivers/gpio/Kconfig.diff
```kconfig
--- ./vanilla//drivers/gpio/Kconfig	2010-02-23 17:38:51.000000000 +0200
+++ ./default//drivers/gpio/Kconfig	2012-05-23 10:43:57.647935508 +0300
@@ -172,6 +172,24 @@
 	  To compile this driver as a module, choose M here: the module will
 	  be called adp5520-gpio.
 
+config GPIO_SX150X
+	tristate "SX150x I2C GPIO expander"
+	depends on I2C
+	default n
+	help
+	  Say yes here to provide support for the Semtech SX150x I2C
+	  GPIO expanders.
+
+config MPP_PMIC8901
+	tristate "Qualcomm PMIC8901 MPP"
+	depends on GPIOLIB && PMIC8901
+	default y
+	help
+	  Say yes here to support GPIO functionality on Qualcomm's
+	  PM8901 chip for MPP(Multi-Purpose Pin) pins. These pins
+	  work like GPIO pins when configured as digital input and/or
+	  output signals.
+
 comment "PCI GPIO expanders:"
 
 config GPIO_BT8XX
```

## kernels/patches/vanilla/drivers/gpu/drm/Kconfig.diff
```kconfig
--- ./vanilla//drivers/gpu/drm/Kconfig	2010-02-23 17:38:51.000000000 +0200
+++ ./default//drivers/gpu/drm/Kconfig	2012-05-23 10:43:57.649935508 +0300
@@ -6,7 +6,7 @@
 #
 menuconfig DRM
 	tristate "Direct Rendering Manager (XFree86 4.1.0 and higher DRI support)"
-	depends on (AGP || AGP=n) && PCI && !EMULATED_CMPXCHG && MMU
+	depends on !EMULATED_CMPXCHG && MMU
 	select I2C
 	select I2C_ALGOBIT
 	help
@@ -16,7 +16,7 @@
 	  These modules provide support for synchronization, security, and
 	  DMA transfers. Please see <http://dri.sourceforge.net/> for more
 	  details.  You should also select and configure AGP
-	  (/dev/agpgart) support.
+	  (/dev/agpgart) support if it is available for your platform.
 
 config DRM_KMS_HELPER
 	tristate
```

## kernels/patches/vanilla/drivers/hwmon/Kconfig.diff
```kconfig
--- ./vanilla//drivers/hwmon/Kconfig	2010-02-23 17:38:51.000000000 +0200
+++ ./default//drivers/hwmon/Kconfig	2012-05-23 10:43:57.697935506 +0300
@@ -623,6 +623,16 @@
 	  This driver can also be built as a module.  If so, the module
 	  will be called max6650.
 
+config SENSORS_MSM_ADC
+	tristate "MSM ADC Driver for current measurement"
+	depends on ARCH_MSM7X30
+	default n
+	help
+	  Say yes here to include support for measuring current in real-time
+	  from various power-rails on the Fluid board.  The ADC circuit
+	  internally uses an array of LTC2499 ADCs in a differential
+	  configuration to provide a flat set of channels that can be addressed.
+
 config SENSORS_PC87360
 	tristate "National Semiconductor PC87360 family"
 	select HWMON_VID
```

## kernels/patches/vanilla/drivers/i2c/busses/Kconfig.diff
```kconfig
--- ./vanilla//drivers/i2c/busses/Kconfig	2010-02-23 17:38:51.000000000 +0200
+++ ./default//drivers/i2c/busses/Kconfig	2012-05-23 10:43:57.715935505 +0300
@@ -429,6 +429,41 @@
 	  This driver can also be built as a module.  If so, the module
 	  will be called i2c-mpc.
 
+config I2C_MSM
+	tristate "MSM"
+	depends on I2C && (ARCH_MSM || ARCH_QSD)
+	default y
+	help
+	  If you say yes to this option, support will be included for the
+	  built-in I2C interface on the MSM or QSD family processors.
+
+config GPIO_I2C_ADPT
+	tristate "GPIO I2C ADAPTER"
+	depends on I2C && (ARCH_MSM || ARCH_QSD)
+	default n
+	help
+	  If you say yes to this option, support will be included for the
+	  S7 GPIO simulate I2C
+
+config I2C_QUP
+	tristate "I2C_QUP"
+	depends on I2C && (ARCH_MSM7X30 || ARCH_MSM8X60 || (ARCH_QSD8X50 && MSM_SOC_REV_A))
+	default y
+	help
+	  If you say yes to this option, support will be included for the
+	  built-in I2C interface on the MSM family processors.
+
+config I2C_SSBI
+	tristate "Qualcomm Single-wire Serial Bus Interface (SSBI)"
+	depends on I2C && (ARCH_MSM7X30 || ARCH_MSM8X60)
+	default n
+	help
+	  If you say yes to this option, support will be included for the
+	  built-in SSBI interface on the MSM family processors.
+
+          Note that SSBI is not an I2C device, but is functionally related
+          enough such that it is able to leverages the I2C framework.
+
 config I2C_MV64XXX
 	tristate "Marvell mv64xxx I2C Controller"
 	depends on (MV64X60 || PLAT_ORION) && EXPERIMENTAL
```

## kernels/patches/vanilla/drivers/input/Kconfig.diff
```kconfig
--- ./vanilla//drivers/input/Kconfig	2010-02-23 17:38:51.000000000 +0200
+++ ./default//drivers/input/Kconfig	2012-05-23 10:43:57.782935502 +0300
@@ -149,6 +149,15 @@
 	  To compile this driver as a module, choose M here: the
 	  module will be called apm-power.
 
+config INPUT_KEYRESET
+	tristate "Reset key"
+	depends on INPUT
+	---help---
+	  Say Y here if you want to reboot when some keys are pressed;
+
+	  To compile this driver as a module, choose M here: the
+	  module will be called keyreset.
+
 config XEN_KBDDEV_FRONTEND
 	tristate "Xen virtual keyboard and mouse support"
 	depends on XEN_FBDEV_FRONTEND
@@ -169,9 +178,17 @@
 source "drivers/input/tablet/Kconfig"
 
 source "drivers/input/touchscreen/Kconfig"
+source "drivers/input/accelerometer/Kconfig"
 
 source "drivers/input/misc/Kconfig"
 
+source "drivers/input/pedestal/Kconfig"
+
+source "drivers/input/cypress_120/Kconfig"
+
+source "drivers/input/dock/Kconfig"
+
+source "drivers/input/belasigna/Kconfig"
 endif
 
 menu "Hardware I/O ports"
```
