## kernels/patches/vanilla/drivers/input/keyboard/Kconfig.diff
```kconfig
--- ./vanilla//drivers/input/keyboard/Kconfig	2010-02-23 17:38:51.000000000 +0200
+++ ./default//drivers/input/keyboard/Kconfig	2012-05-23 10:43:57.791935502 +0300
@@ -413,6 +413,14 @@
 	  To compile this driver as a module, choose M here: the
 	  module will be called xtkbd.
 
+config KEYBOARD_QCIKBD
+   tristate "Quanta Computer Inc. keyboard"
+   depends on I2C && ARCH_MSM_SCORPION
+   default n
+   help
+     Say Y here if you want to use the Quanta keyboard driver for ST 1.5
+     platform.
+
 config KEYBOARD_W90P910
 	tristate "W90P910 Matrix Keypad support"
 	depends on ARCH_W90X900
@@ -423,4 +431,47 @@
 	  To compile this driver as a module, choose M here: the
 	  module will be called w90p910_keypad.
 
+config KEYBOARD_I2C_MSM
+	tristate "Qualcomm I2C keyboard"
+	depends on I2C && ARCH_MSM_SCORPION
+	default n
+	help
+	  Say Y here if you want to enable the driver for the I2C QWERTY
+	  keyboard provided as a reference design from Qualcomm. This is
+	  intended to support an integrated keyboard that is connected via
+	  four GPIO pins on the 8K platforms. The GPIO pins are set up for
+	  an external interrupt, hardware reset, and the two I2C lines
+	  connected to the internal i2c controller.
+
+config KEYBOARD_PMIC8058
+	tristate "Qualcomm PMIC8058 keypad"
+	depends on PMIC8058
+	default y
+	help
+	  Say Y here if you want to enable the driver for the PMIC8058
+	  keypad provided as a reference design from Qualcomm. This is intended
+	  to support upto 18x8 matrix based keypad design.
+
+	  To compile this driver as a module, choose M here: the module will
+	  be called pmic8058-keypad.
+	  
+config RMT_CTRL_NEC
+	tristate "Remote control key support"
+	depends on I2C && ARCH_MSM_SCORPION
+	default n
+	help
+	  Say Y here if you want to use a remote control keypad .
+
+	  To compile this driver as a module, choose M here: the
+	  module will be called rmt_ctrl.
+	  
+config REMOTE_CONTROL_GPIO
+tristate "Remote control through gpio decord key support"
+	depends on GENERIC_GPIO
+	default n
+	help
+	  Say Y here if you want to use a remote control keypad .
+
+	  To compile this driver as a module, choose M here: the
+	  module will be called rmt_ctrl_gpio.
 endif
```

## kernels/patches/vanilla/drivers/input/misc/Kconfig.diff
```kconfig
--- ./vanilla//drivers/input/misc/Kconfig	2010-02-23 17:38:51.000000000 +0200
+++ ./default//drivers/input/misc/Kconfig	2012-05-23 10:43:57.796935501 +0300
@@ -132,6 +132,17 @@
 	  To compile this driver as a module, choose M here: the module will be
 	  called ati_remote2.
 
+config INPUT_KEYCHORD
+	tristate "Key chord input driver support"
+	help
+	  Say Y here if you want to enable the key chord driver
+	  accessible at /dev/keychord.  This driver can be used
+	  for receiving notifications when client specified key
+	  combinations are pressed.
+
+	  To compile this driver as a module, choose M here: the
+	  module will be called keychord.
+
 config INPUT_KEYSPAN_REMOTE
 	tristate "Keyspan DMR USB remote control (EXPERIMENTAL)"
 	depends on EXPERIMENTAL
@@ -240,6 +251,11 @@
 	  To compile this driver as a module, choose M here: the module will be
 	  called winbond_cir.
 
+config INPUT_GPIO
+	tristate "GPIO driver support"
+	help
+	  Say Y here if you want to support gpio based keys, wheels etc...
+
 config HP_SDC_RTC
 	tristate "HP SDC Real Time Clock"
 	depends on (GSC || HP300) && SERIO
@@ -317,4 +333,42 @@
 	  To compile this driver as a module, choose M here: the
 	  module will be called pcap_keys.
 
+config INPUT_CAPELLA_CM3602
+	tristate "Capella CM3602 proximity and light sensor"
+	help
+	  Say Y here to enable the Capella CM3602 Short Distance Proximity
+	  Sensor with Ambient Light Sensor.
+
+config PMIC8058_PWRKEY
+	tristate "PMIC8058 power key support"
+	default n
+	depends on PMIC8058
+	help
+	  Say Y here if you want support for the PMIC8058 power key.
+
+	  To compile this driver as a module, choose M here: the
+	  module will be called pmic8058-pwrkey.
+
+config PMIC8058_OTHC
+	tristate "Qualcomm PMIC8058 OTHC support"
+	default n
+	depends on PMIC8058
+	help
+	  Say Y here if you want support PMIC8058 OTHC.
+
+	  To compile this driver as a module, choose M here: the
+	  module will be called pmic8058-othc.
+
+config INPUT_KP_FLIP_SWITCH
+	tristate "flip switch detection support"
+	default y
+	depends on PMIC8058 && ARCH_MSM7X30
+	help
+	  Say Y here if you want support for the flip switch detection.
+	  This driver can be used with Qualcomm MSM7x30 based development
+	  platforms which have flip switch as part of the PMIC8058 keypad.
+
+	  To compile this driver as a module, choose M here: the
+	  module will be called kp_flip_switch.
+
 endif
```

## kernels/patches/vanilla/drivers/input/mouse/Kconfig.diff
```kconfig
--- ./vanilla//drivers/input/mouse/Kconfig	2010-02-23 17:38:51.000000000 +0200
+++ ./default//drivers/input/mouse/Kconfig	2012-05-23 10:43:57.801935501 +0300
@@ -270,6 +270,16 @@
 	  described in the source file). This driver also works with the
 	  digitizer (VSXXX-AB) DEC produced.
 
+config MOUSE_OFN_HID
+	tristate "hid Optical finger navigation"
+	depends on ARCH_MSM_SCORPION && I2C_MSM
+	default n
+	help
+	  Say Y here if you have an hid OFN device attached.
+
+	  To compile this driver as a module, choose M here: the
+	  module will be called ofn_hid.
+
 config MOUSE_GPIO
 	tristate "GPIO mouse"
 	depends on GENERIC_GPIO
```
